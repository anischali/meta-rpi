## conf/distro/visilinux.conf
```bitbake
require conf/distro/distro-features.inc


DISTRO = "visilinux"    
DISTRO_NAME = "VISI Linux distribution"      
DISTRO_VERSION = "1.0"

DISTRO_CODENAME = "visilinux"  
```

## conf/layer.conf
```bitbake
# We have a conf and classes directory, add to BBPATH
BBPATH .= ":${LAYERDIR}"

# We have recipes-* directories, add to BBFILES
BBFILES += "${LAYERDIR}/recipes-*/*/*.bb \
	        ${LAYERDIR}/recipes-*/*/*/*.bb \
            ${LAYERDIR}/recipes-*/*/*.bbappend \
            ${LAYERDIR}/recipes-*/*/*/*.bbappend \
"

BBFILE_COLLECTIONS += "rpi-layer"
BBFILE_PATTERN_rpi-layer = "^${LAYERDIR}/"
BBFILE_PRIORITY_rpi-layer = "4"
LAYERSERIES_COMPAT_rpi-layer = "kirkstone"
LAYERSERIES_CORENAMES = "kirkstone"
LAYERDEPENDS_rpi-layer = "raspberrypi"


LICENSE_FLAGS_ACCEPTED="commercial"
VIDEO_CAMERA = "1"

DISTRO_FEATURES:append = " systemd wifi"
DISTRO_FEATURES_BACKFILL_CONSIDERED += "sysvinit"
VIRTUAL-RUNTIME:init_manager = "systemd"
VIRTUAL-RUNTIME:initscripts = "systemd-compat-units"
```

## conf/machine/raspberry-pi.conf
```bitbake
PREFERRED_VERSION_linux-raspberrypi ?= "5.15"

LICENSE_FLAGS_ACCEPTED="commercial"

VIDEO_CAMERA = "1"
```

## conf/machine/raspberry-pi0.conf
```bitbake
MACHINEOVERRIDES =. "rpi:raspberrypi:raspberry-pi0:"

include raspberry-pi.conf
include conf/machine/raspberrypi0-wifi.conf

MACHINE_FEATURES:append = " usbgadget"
```

## conf/machine/raspberry-pi3.conf
```bitbake
MACHINEOVERRIDES =. "raspberry-pi3:"

include conf/machine/raspberrypi3.conf


PREFERRED_VERSION_linux-raspberrypi ?= "5.4.%"
```

## conf/machine/raspberry-pi3b.conf
```bitbake
MACHINEOVERRIDES =. "raspberrypi3:raspberry-pi3b:"

include raspberry-pi.conf
include conf/machine/raspberrypi3.conf
```
